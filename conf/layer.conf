## conf/layer.conf
```bitbake
# We have a conf and classes directory, add to BBPATH 
BBPATH .= ":${LAYERDIR}" 

# We have recipes-* directories, add to BBFILES 
BBFILES += "${LAYERDIR}/recipes-*/*/*.bb \ 
  ${LAYERDIR}/recipes-*/*/*.bbappend" 

BBFILE_COLLECTIONS += "pimike" 
BBFILE_PATTERN_pimike = "^${LAYERDIR}/" 
BBFILE_PRIORITY_pimike = "6" 

LAYERSERIES_COMPAT_pimike = "mickledore" 

MACHINE ?= "raspberrypi3"
LICENSE_FLAGS_ACCEPTED = "synaptics-killswitch commercial"
# Enable the serial port
ENABLE_UART = "1"
# Allow picameras to work
VIDEO_CAMERA = "1"

DISTRO_FEATURES:remove = "3g alsa bluetooth ipv6 irda opengl nfc pcmia phone pulseadio "
```
